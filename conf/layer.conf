## conf/layer.conf
```bitbake
BBPATH .= ":${LAYERDIR}"

BBFILES += "${LAYERDIR}/recipes-*/*/*.bb \
            ${LAYERDIR}/recipes-*/*/*.bbappend"

# Exclude the example extended recipe by default
BBMASK .= "|barton-matter-example/barton-matter_1.4.0.bbappend"

BBFILE_COLLECTIONS += "rdke-iot"
BBFILE_PATTERN_rdke-iot = "^${LAYERDIR}/"
BBFILE_PRIORITY_rdke-iot = "5"
LAYERVERSION_rdke-iot = "1"
LAYERSERIES_COMPAT_rdk-iot = "kirkstone"
```
